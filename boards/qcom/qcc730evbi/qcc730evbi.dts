/*
 * qcc730evbi
 *
 * Copyright (c) Qualcomm Technologies, Inc. and/or its subsidiaries.
 * SPDX-License-Identifier: Apache-2.0
 */

/dts-v1/;

#include <qcom/qcc730.dtsi>
#include <arm/qcom/qcc730-pinctrl.dtsi>

/ {
	model = "QCC730EVBI";
	compatible = "qcom,qcc730evbi";

	chosen {
		zephyr,console = &uart0;
		zephyr,shell-uart = &uart0;
		zephyr,sram = &sram0;
		zephyr,flash = &flash0;
	};
};

&uart0 {
	pinctrl-0 = <&uart0_option3>;
	pinctrl-names = "default";
	status = "okay";
	current-speed = <115200>;
	parity = "none";
	stop-bits = "1";
	data-bits = <8>;
};
