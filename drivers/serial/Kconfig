## dts/bindings/serial/qcom,uart_qcc730.yaml
```yaml
# Copyright (c) Qualcomm Technologies, Inc. and/or its subsidiaries.
# SPDX-License-Identifier: Apache-2.0;
description: QCC730 UART

compatible: "qcom,uart_qcc730"

include: [uart-controller.yaml]

properties:
  reg:
    required: true

  interrupts:
    required: true

  current-speed:
    description: |
      Initial baud rate setting for UART. Defaults to standard baudrate of 115200 if not specified.
    default: 115200

  stop-bits:
    description: |
      Sets the number of stop bits. Defaults to standard of 1 if not specified.
    default: "1"

  data-bits:
    description: |
      Sets the number of data bits. Defaults to standard of 8 if not specified.
    default: 8
```

## dts/bindings/spi/qcom,qcc730-spi.yaml
```yaml
# Copyright (c) Qualcomm Technologies, Inc. and/or its subsidiaries.
# SPDX-License-Identifier: Apache-2.0

compatible: "qcom,qcc730-spi"

include: [spi-controller.yaml, pinctrl-device.yaml]

properties:
  reg:
    required: true

  interrupts:
    required: true

  pinctrl-0:
    required: true

  pinctrl-names:
    required: true

  pin-num:
    type: int
    required: true
    description: |
      Number of the pin initialized as input. Slave DW GPIO pin.
    default: 5
```

## dts/bindings/watchdog/qcom,qcc730-wdt.yaml
```yaml
description: Qualcomm QCC730 watchdog

compatible: "qcom,qcc730-wdt"

include: base.yaml
```

## dts/bindings/wifi/qcom,qwifi_drv.yaml
```yaml
# Copyright (c) Qualcomm Technologies, Inc. and/or its subsidiaries.
# SPDX-License-Identifier: Apache-2.0;
description: Qualcomm SoC WiFi

compatible: "qcom,qwifi_drv"
```

## dts/bindings/wifi/qualcomm,qwifi_drv.yaml
```yaml
# Copyright (c) Qualcomm Technologies, Inc. and/or its subsidiaries.
# SPDX-License-Identifier: Apache-2.0;
description: Qualcomm SoC WiFi

compatible: "qualcomm,qwifi_drv"
```
