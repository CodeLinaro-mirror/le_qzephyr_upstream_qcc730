## drivers/serial/Kconfig
```kconfig
# Copyright (c) Qualcomm Technologies, Inc. and/or its subsidiaries.
# SPDX-License-Identifier: Apache-2.0;
if SERIAL

rsource "Kconfig.qcc730"

endif # SERIAL
```

## drivers/serial/Kconfig.qcc730
```kconfig
# Copyright (c) Qualcomm Technologies, Inc. and/or its subsidiaries.
# SPDX-License-Identifier: Apache-2.0
# Qualcomm QCC730 UART configuration options

config UART_QCC730
	bool "Qualcomm QCC730 UART driver"
	default y
	# select SERIAL_SUPPORT_INTERRUPT
	depends on PINCTRL
	depends on DT_HAS_QCOM_QCC730_PINCTRL_ENABLED
	depends on SERIAL
	depends on DT_HAS_QCOM_QCC730_UART_ENABLED
	select RING_BUFFER
	depends on SOC_QCC730_HAS_UART_V2
	select BOARD_QCC730_UART_ENABLE
	select SERIAL_HAS_DRIVER
	select UART_QCC730_LL
	select UART_HAL
	help
	  Enable support for the Qualcomm QCC730 UART controllers.
```

## drivers/spi/Kconfig
```kconfig
# Copyright (c) Qualcomm Technologies, Inc. and/or its subsidiaries.
# SPDX-License-Identifier: Apache-2.0

config SPI_QCC730
	bool "Qualcomm QCC730 SPI slave driver"
	default y
	depends on SPI
	depends on DT_HAS_QCOM_QCC730_SPI_ENABLED
	help
	  Enable support for the Qualcomm QCC730 SPI slave controller.
```

## drivers/watchdog/Kconfig.qcc730
```kconfig
# Copyright (c) Qualcomm Technologies, Inc. and/or its subsidiaries.
# SPDX-License-Identifier: Apache-2.0
# Qualcomm QCC730 Watchdog configuration options

config WATCHDOG_QCC730
	bool "Qualcomm QCC730 Watchdog driver"
	default y
	depends on WATCHDOG
	depends on DT_HAS_QCOM_QCC730_WATCHDOG_ENABLED
	help
	  Enable QCC730 watchdog driver support.
	  Always ensures all watchdog code is compiled.

config QWDT
	bool "Enable QWDT functionality"
	help
	  Enable actual QWDT (Qualcomm Watchdog) functionality.
	  
	  If enabled (y):
	    - Watchdog will be initialized and started
	    - Automatic feeding will be enabled
	    - PM callbacks will feed the watchdog
	    - All watchdog features are functional
	  
	  If disabled (n):
	    - Watchdog code is compiled but not functional
	    - All watchdog operations become no-ops
	    - Zero runtime overhead
```

## drivers/wifi/Kconfig
```kconfig
# Copyright (c) Qualcomm Technologies, Inc. and/or its subsidiaries.
# SPDX-License-Identifier: Apache-2.0;
rsource "qcom/Kconfig.qcom"

config NET_L2_ETHERNET_RESERVE_HEADER
	default y

config NET_BUF_DATA_SIZE
	default 512
```

## drivers/wifi/qcom/Kconfig.qcom
```kconfig
# Copyright (c) Qualcomm Technologies, Inc. and/or its subsidiaries.
# SPDX-License-Identifier: Apache-2.0;
config WIFI_QCOM
	bool "Qcom wifi driver"
	select QWIFI
	select QCRYPTO
	select WIFI_USE_NATIVE_NETWORKING if NETWORKING
	select NET_L2_WIFI_MGMT if NETWORKING
	select NET_L2_ETHERNET_MGMT if NETWORKING && NET_L2_ETHERNET
	select MBEDTLS_MD5 if MBEDTLS
	#default y
	default n

config WIFI_QCOM_ENTERPRISE
	bool "QCC730 WPA2-Enterprise (802.1X/EAP) support"
	depends on WIFI_QCOM
	depends on WIFI_NM_WPA_SUPPLICANT
	depends on WIFI_NM_WPA_SUPPLICANT_CRYPTO_ENTERPRISE
	help
	  Enables WPA2-Enterprise (802.1X EAP-TLS/PEAP/TTLS) for QCC730.
	  The host wpa_supplicant EAP state machine runs after firmware
	  completes 802.11 authentication and association.
	  Non-enterprise paths (open/PSK/SAE) are not affected.

	  Requires the full supplicant build (WIFI_NM_WPA_SUPPLICANT_MINIMAL=n)
	  so supp_main creates the wpa_supplicant context and runs eloop_run()
	  in its own thread, and driver_zephyr.c provides
	  wpa_supplicant_event_wrapper used by qcom_wifi_enterprise_glue.

config WIFI_NM_WPA_SUPPLICANT_NAN_USD
	bool "Wi-Fi Aware Unsynchronized Service Discovery (NAN USD)"
	depends on WIFI_NM_WPA_SUPPLICANT
	help
	  Enable NAN USD support (FR203517) for device discovery without AP
	  association, used for Matter Wi-Fi-only commissioning.

config WIFI_NM_WPA_SUPPLICANT_NAN
	bool
	default y if WIFI_NM_WPA_SUPPLICANT_NAN_USD
	select WIFI_NM_WPA_SUPPLICANT_MINIMAL
	select WIFI_QCOM_HOSTAP_ELOOP
	help
	  Internal: enables nan_de.c compilation and the hostap eloop thread
	  for NAN USD support. Auto-selected by WIFI_NM_WPA_SUPPLICANT_NAN_USD.

config WIFI_NM_WPA_SUPPLICANT_MINIMAL
	bool "Minimal hostap build (utils only, no protocol stack)"
	help
	  Build only the hostap utility layer (eloop / os / wpa_debug /
	  wpabuf / common). The WPA/EAP protocol stack is provided externally
	  (e.g. by firmware on a co-processor).

config WIFI_QCOM_HOSTAP_ELOOP
	bool "Run hostap eloop thread for QCC730 (MINIMAL builds)"
	depends on WIFI_QCOM
	depends on WIFI_NM_WPA_SUPPLICANT_MINIMAL
	select ZVFS
	select ZVFS_EVENTFD
	help
	  Compiles qcom_hostap_eloop.c and starts a Zephyr thread that runs
	  hostap's eloop_run(), so registered timeouts (p2p_state_timeout,
	  nan_de_timer, EAPOL retransmits, etc.) actually fire when supp_main
	  is not linked.

	  Only meaningful with WIFI_NM_WPA_SUPPLICANT_MINIMAL=y — in a full
	  supplicant build supp_main already runs eloop_run() in its own
	  thread, and this helper would be a duplicate. Enable this when
	  application code uses hostap state machines directly (e.g. P2P,
	  NAN USD via nan_de.c) and posts work to the eloop via
	  qcom_hostap_post(). Auto-selected by WIFI_QCOM_P2P.

	  ZVFS_EVENTFD is the wake mechanism between WMI event handlers and
	  the eloop thread — same model supp_main.c uses with the full
	  supplicant.

config WIFI_QCOM_WPS
	bool "WPS Enrollee support for QCC730 (PBC + PIN)"
	depends on WIFI_QCOM
	select WIFI_NM_WPA_SUPPLICANT
	select WIFI_NM_WPA_SUPPLICANT_MINIMAL
	select WIFI_QCOM_HOSTAP_ELOOP
	help
	  Enables WPS Enrollee (PBC and PIN methods) for QCC730 using a
	  firmware-assisted WPS scan path.  The firmware performs the WPS IE
	  scan and AP discovery; the host handles EAP-WSC (M1-M8) via the
	  hostap WPS protocol stack.

	  Can be disabled to save flash when WPS is not required.

config WPS_MANUFACTURER
	string "WPS manufacturer string"
	depends on WIFI_QCOM_WPS
	default "Qualcomm"
	help
	  Manufacturer string included in WPS IE and M1 message.

config WPS_MODEL_NAME
	string "WPS model name string"
	depends on WIFI_QCOM_WPS
	default "ModelName"
	help
	  Model name string included in WPS IE and M1 message.

config WPS_MODEL_NUMBER
	string "WPS model number string"
	depends on WIFI_QCOM_WPS
	default "123456790"
	help
	  Model number string included in WPS IE and M1 message.

config WPS_SERIAL_NUMBER
	string "WPS serial number string"
	depends on WIFI_QCOM_WPS
	default "123456"
	help
	  Serial number string included in WPS IE and M1 message.

config WPS_DEVICE_NAME
	string "WPS device name string"
	depends on WIFI_QCOM_WPS
	default "IOT-NT"
	help
	  Device name string included in WPS IE and M1 message.

config WIFI_NM_WPA_SUPPLICANT_P2P_EXT
	bool "P2P state machine on top of MINIMAL (external supplicant)"
	depends on WIFI_NM_WPA_SUPPLICANT_MINIMAL
	help
	  Link the hostap P2P state machine (p2p.c and friends) on top of the
	  MINIMAL utility layer. Used by the QCC730 P2P build where group
	  formation, provisioning and key management are handled outside the
	  in-tree supplicant.

config WIFI_NM_WPA_SUPPLICANT_P2P_NO_DEBUG
	bool "Stub out P2P internal p2p_dbg/p2p_info/p2p_err format strings"
	depends on WIFI_NM_WPA_SUPPLICANT_P2P_EXT
	help
	  hostap's P2P core uses its own p2p_dbg/p2p_info/p2p_err functions.
	  This option compile-time stubs them to ((void)0), which lets the
	  linker garbage-collect ~30 KB of P2P format-string literals from
	  .rodata. Functional impact: lose all p2p_dbg/info/err output; the
	  wpa_msg/wpa_printf path is unaffected.

config WIFI_QCOM_P2P
	bool "QCC730 P2P (Wi-Fi Direct) device discovery support"
	depends on WIFI_QCOM
	depends on WIFI_NM_WPA_SUPPLICANT
	depends on WIFI_NM_WPA_SUPPLICANT_P2P_EXT
	select WIFI_QCOM_HOSTAP_ELOOP
	help
	  Enable P2P find / discovery for QCC730. The host hostap p2p core
	  drives state, while qapi_WLAN_P2P_Find() forwards WMI commands to
	  firmware which performs the social/full channel scan. Group
	  formation, provisioning and service discovery are not implemented
	  in this minimal flavor.

config WIFI_QCOM_AUTO_DHCPV4
	bool "Automatically starts DHCP4 negotiation"
	depends on WIFI_QCOM
	depends on NET_IPV4
	depends on NET_DHCPV4
	help
	  WiFi driver will automatically initiate DHCPV4 negotiation when connected.

config WIFI_SHELL_MAX_AP_STA
	int "Maximum number of APs and STAs that can be managed in Wi-Fi shell"
	default 4
```

## drivers/wifi/qualcomm/Kconfig.qualcomm
```kconfig
# Copyright (c) Qualcomm Technologies, Inc. and/or its subsidiaries.
# SPDX-License-Identifier: Apache-2.0;
config WIFI_QUALCOMM
	bool "QUALCOMM wifi driver"
	select QWIFI
	select WIFI_USE_NATIVE_NETWORKING if NETWORKING
	select NET_L2_WIFI_MGMT if NETWORKING
	select NET_L2_ETHERNET_MGMT if NETWORKING && NET_L2_ETHERNET
	#default y
	default n

if CONFIG_WIFI_QUALCOMM


endif # CONFIG_WIFI_QUALCOMM
```

## dts/bindings/clock/qcom,qcc730-clkctrl.yaml
```yaml
# Copyright (c) Qualcomm Technologies, Inc. and/or its subsidiaries.
#
# SPDX-License-Identifier: Apache-2.0

description: Qualcomm QCC730 Clock Control

compatible: "qcom,qcc730-clkctrl"

include: [clock-controller.yaml, base.yaml]

properties:
  reg:
    required: true
    description: PMU register base address

clock-cells:
  - id
```

## dts/bindings/counter/qcom,qcc730-qtimer.yaml
```yaml
# Copyright (c) Qualcomm Technologies, Inc. and/or its subsidiaries.
# SPDX-License-Identifier: Apache-2.0

description: QCC730 Qtimer node

compatible: "qcom,qcc730-qtimer"

include: [reset-device.yaml, base.yaml]

properties:
  clock-frequency:
    type: int
    required: true
    description: Frequency of the Qtimer clock in Hz

  resets:
    required: true
```

## dts/bindings/counter/qcom,qcc730-qtmr.yaml
```yaml
# Copyright (c) Qualcomm Technologies, Inc. and/or its subsidiaries.
# SPDX-License-Identifier: Apache-2.0

description: QCC730 Qtimer frame node

compatible: "qcom,qcc730-qtmr"

include: base.yaml

properties:
  reg:
    required: true

  interrupts:
    required: true

  id:
    type: int
    required: true
    description: Qtimer frame ID
```

## dts/bindings/dma/qcom,qcc730-dxe.yaml
```yaml
# Copyright (c) Qualcomm Technologies, Inc. and/or its subsidiaries.
# SPDX-License-Identifier: Apache-2.0

description: QCC730 DXE
compatible: "qcom,qcc730-dxe"

include: dma-controller.yaml

properties:
  reg:
    required: true

  interrupts:
    required: true
```

## dts/bindings/drv_dummy/qualcomm,drv_dummy_qcc730.yaml
```yaml
# Copyright (c) Qualcomm Technologies, Inc. and/or its subsidiaries.
# SPDX-License-Identifier: Apache-2.0;
description: qualcomm sample driver

compatible: "qualcomm,drv_dummy_qcc730"

include: [base.yaml]

properties:
    reg:
      required: true
```

## dts/bindings/flash_controller/qcom,qspi-qcc730-nor.yaml
```yaml
# Copyright (c) Qualcomm Technologies, Inc. and/or its subsidiaries.
# SPDX-License-Identifier: Apache-2.0

description: Qualcomm Quad-SPI NOR flash controller

compatible: "qcom,qspi-qcc730-nor"

include: flash-controller.yaml
include: base.yaml

properties:
  device-id:
    type: int
    description: ID of the flash device that is expected to be obtained in initialization phase
```

## dts/bindings/gpio/qcom,qcc730-gpio.yaml
```yaml
# Copyright (c) Qualcomm Technologies, Inc. and/or its subsidiaries.
# SPDX-License-Identifier: Apache-2.0

description: QCC730 GPIO node

compatible: "qcom,qcc730-gpio"

include: [gpio-controller.yaml, reset-device.yaml, base.yaml]

properties:
  reg:
    required: true
  "#gpio-cells":
    const: 2

  resets:
    required: true

gpio-cells:
  - pin
  - flags
```

## dts/bindings/i2c/qcom,qcc730-i2c.yaml
```yaml
# Copyright (c) Qualcomm Technologies, Inc. and/or its subsidiaries.
# SPDX-License-Identifier: Apache-2.0

description: QCC730 I2C support

compatible: qcom,qcc730-i2c

include: [i2c-controller.yaml, reset-device.yaml]

properties:
  periph-clock-frequency_khz:
    type: int
    description: I2C peripheral clock frequency in kHz

  resets:
    required: true
```

## dts/bindings/pinctrl/qcom,qcc730-pinctrl.yaml
```yaml
# Copyright (c) 2025 Qualcomm Technologies, Inc. and/or its subsidiaries
# SPDX-License-Identifier: Apache-2.0

description: |
  Qualcomm QCC730 pin control
  Qualcomm QCC730 pin controller pin configuration group. Each group contains
  a list of pins sharing the same set of properties. Example:
  uart0_option0: uart0_option0 {
    group1 {
      pinmux = <QCC730_PINMUX_UART_PERIPHERAL(QCC730_GPIO_11, QCC730_UART_OPTION_0)>,
                <QCC730_PINMUX_UART_PERIPHERAL(QCC730_GPIO_12, QCC730_UART_OPTION_0)>;
      bias-pull-up;
      high-drive-strength;
    };
  };

compatible: "qcom,qcc730-pinctrl"

include: base.yaml

properties:
  "#pinctrl-cells":
    type: int
    const: 1

child-binding:
  description: |
    Qualcomm QCC730 pin controller pin configuration nodes.
  child-binding:
    description: |
      The grandchild nodes group pins that share the same pin configuration.

    include:
      - name: pincfg-node.yaml
        property-allowlist:
          - bias-pull-down
          - bias-pull-up
          - bias-disable

    properties:
      pinmux:
        required: true
        type: array
        description: |
          An array of pins sharing the same group properties. The pins should be
          defined using the QCC730_PINMUX utility macros that encode the pin
          configuration including pin number, function, mode, and UART option.

      high-drive-strength:
        type: boolean
        description: Enable high drive strength for the pin.
```

## dts/bindings/reset/qcom,qcc730-reset.yaml
```yaml
# Copyright (c) Qualcomm Technologies, Inc. and/or its subsidiaries.
# SPDX-License-Identifier: Apache-2.0

description: |
  QCC730 Reset Controller.

  This node is in charge of reset control for PMU and MCU domains.

  To specify the reset line in a peripheral, the standard resets property needs
  to be used, e.g.:

    uart0: uart@xxx {
        ...
        /* Cell contains information about reset register (PMU_SOFT_RESET or MCU_SOFT_RESET) and bit */
        resets = <&reset QCC730_RESET(PMU_SOFT_RESET, 11)>;
        ...
    };

  The reset cells are available in
  include/zephyr/dts-bindings/reset/qcom_qcc730_reset.h header files.

compatible: "qcom,qcc730-reset"

include: [reset-controller.yaml, base.yaml]

properties:
  "#reset-cells":
    const: 1

reset-cells:
  - id
```

## dts/bindings/rtc/qcom,qcc730-rtc.yaml
```yaml
# Copyright (c) Qualcomm Technologies, Inc. and/or its subsidiaries.
# SPDX-License-Identifier: Apache-2.0

description: QCC730 Software RTC

compatible: "qcom,qcc730-rtc"

include: [base.yaml, rtc-device.yaml]

properties:
  qtimer-frame:
    type: phandle
    required: true
    description: Node identifier of a Qtimer frame used for RTC
```

## dts/bindings/serial/qcom,qcc730-uart.yaml
```yaml
# Copyright (c) Qualcomm Technologies, Inc. and/or its subsidiaries.
# SPDX-License-Identifier: Apache-2.0

description: Qualcomm QCC730 UART Controller

compatible: "qcom,qcc730-uart"

include: [uart-controller.yaml, pinctrl-device.yaml, reset-device.yaml]

properties:
  reg:
    type: array
    required: true
    description: |
      Base address of UART peripheral

  interrupts:
    type: array
    required: false
    description: |
      Interrupts for the UART controller.

  rx-buffer-size:
    type: int
    required: true
    description: |
      Size of the RX buffer in bytes. If not provided, a default value of 8 bytes is used.
    default: 8

  resets:
    required: true
```
