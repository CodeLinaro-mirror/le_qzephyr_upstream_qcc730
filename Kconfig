## Kconfig
```kconfig
# Copyright (c) Qualcomm Technologies, Inc. and/or its subsidiaries.
# SPDX-License-Identifier: Apache-2.0;
rsource "drivers/Kconfig"
```

## boards/qcom/qcc730evbi/board.yml
```yaml
# Copyright (c) Qualcomm Technologies, Inc. and/or its subsidiaries.
# SPDX-License-Identifier: Apache-2.0;
board:
  name: qcc730evbi
  full_name: QCC730EVBI dev kit
  vendor: qcom
  socs:
  - name: qcc730
```

## boards/qcom/qcc730evbi/qcc730evbi_defconfig
```kconfig
# Copyright (c) Qualcomm Technologies, Inc. and/or its subsidiaries.
# SPDX-License-Identifier: Apache-2.0;

CONFIG_UART_QCC730=y
#for UART GPIO configurations
CONFIG_BOARD_QCC730_UART_GPIO_OPTION=3
CONFIG_QLIB_EARLY_PRINTK=y

# enable uart driver
CONFIG_SERIAL=y

# console
CONFIG_CONSOLE=y
CONFIG_UART_CONSOLE=y

CONFIG_LOG=y
CONFIG_LOG_MODE_MINIMAL=y

CONFIG_SHELL=y
CONFIG_SHELL_BACKENDS=y
CONFIG_SHELL_BACKEND_SERIAL=y

CONFIG_SOC_LOG_LEVEL_DBG=y
```

## boards/qcom/qcc730evbx/board.yml
```yaml
# Copyright (c) Qualcomm Technologies, Inc. and/or its subsidiaries.
# SPDX-License-Identifier: Apache-2.0;
board:
  name: qcc730evbx
  full_name: QCC730EVBX dev kit
  vendor: qcom
  socs:
  - name: qcc730
```

## boards/qcom/qcc730mi/Kconfig.qcc730mi
```kconfig
# Copyright (c) Qualcomm Technologies, Inc. and/or its subsidiaries.
# SPDX-License-Identifier: Apache-2.0

config BOARD_QCC730MI
	select SOC_QCC730
	select PINCTRL
	select SERIAL
	select SERIAL_HAS_DRIVER
	select CONSOLE
	select UART_CONSOLE
```

## boards/qcom/qcc730mi/board.yml
```yaml
# Copyright (c) Qualcomm Technologies, Inc. and/or its subsidiaries.
# SPDX-License-Identifier: Apache-2.0

board:
  name: qcc730mi
  full_name: QCC730MI dev kit
  vendor: qcom
  socs:
    - name: qcc730
```

## boards/qcom/qcc730mx/Kconfig.qcc730mx
```kconfig
# Copyright (c) Qualcomm Technologies, Inc. and/or its subsidiaries.
# SPDX-License-Identifier: Apache-2.0;

config BOARD_QCC730MX
	select SOC_QCC730
	select CLOCK_CONTROL
	select PINCTRL
	select SERIAL
	select SERIAL_HAS_DRIVER
	select CONSOLE
```

## boards/qcom/qcc730mx/board.yml
```yaml
# Copyright (c) Qualcomm Technologies, Inc. and/or its subsidiaries.
# SPDX-License-Identifier: Apache-2.0;
board:
  name: qcc730mx
  full_name: QCC730MX dev kit
  vendor: qcom
  socs:
  - name: qcc730
```

## boards/qcom/qcc730mx/qcc730mx_defconfig
```kconfig
# Copyright (c) Qualcomm Technologies, Inc. and/or its subsidiaries.
# SPDX-License-Identifier: Apache-2.0;

#enable SERIAL
CONFIG_PINCTRL=y
CONFIG_CLOCK_CONTROL=y
CONFIG_SERIAL=y
CONFIG_CONSOLE=y
CONFIG_UART_CONSOLE=y
CONFIG_BOARD_QCC730_UART_GPIO_OPTION=1
CONFIG_UART_QCC730=y
CONFIG_QLIB_EARLY_PRINTK=y

CONFIG_LOG=y
CONFIG_LOG_MODE_MINIMAL=y

CONFIG_SHELL=y
CONFIG_SHELL_BACKENDS=y
CONFIG_SHELL_BACKEND_SERIAL=y

CONFIG_SOC_LOG_LEVEL_DBG=y
CONFIG_EXTRA_EXCEPTION_INFO=y

CONFIG_QCC730_BDF_FILE="mqm730x.bin"
CONFIG_QCC730_SBL_FILE="qcc730mx_sbl_HASHED.elf"
CONFIG_QCC730_PRG_FILE="qcc730mx_prg.elf"

CONFIG_FPU=y

# Flash driver configuration
CONFIG_FLASH=y
CONFIG_FLASH_QCC730=y
CONFIG_FLASH_QCC730_QSPI_QUAD_MODE=y
```

## boards/qualcomm/qcc730evbx/board.yml
```yaml
# Copyright (c) Qualcomm Technologies, Inc. and/or its subsidiaries.
# SPDX-License-Identifier: Apache-2.0;
board:
  name: qcc730evbx
  full_name: qcc730evbx
  vendor: qualcomm
  socs:
  - name: qcc730
```

## boards/qualcomm/qcc730evbx/qcc730evbx_defconfig
```kconfig
# Copyright (c) Qualcomm Technologies, Inc. and/or its subsidiaries.
# SPDX-License-Identifier: Apache-2.0;
CONFIG_SYS_CLOCK_HW_CYCLES_PER_SEC=60000000
CONFIG_SYS_CLOCK_TICKS_PER_SEC=1000

CONFIG_HEAP_MEM_POOL_SIZE=262144

CONFIG_DRV_DUMMY=y
CONFIG_DRV_DUMMY_QCC730=y

# Execute from RAM
CONFIG_XIP=y

CONFIG_UART_QCC730=y
#for UART GPIO configurations
CONFIG_BOARD_QCC730_UART_GPIO_OPTION=3
CONFIG_QLIB_EARLY_PRINTK=y

# enable uart driver
CONFIG_SERIAL=y

# console
CONFIG_CONSOLE=y
CONFIG_UART_CONSOLE=y

CONFIG_LOG=y
CONFIG_LOG_MODE_MINIMAL=y

CONFIG_SHELL=y
CONFIG_SHELL_BACKENDS=y
CONFIG_SHELL_BACKEND_SERIAL=y

CONFIG_QWIFI=y
CONFIG_SOC_LOG_LEVEL_DBG=y
```

## drivers/Kconfig
```kconfig
# Copyright (c) Qualcomm Technologies, Inc. and/or its subsidiaries.
# SPDX-License-Identifier: Apache-2.0

menu "Drivers"
rsource "clock_control/Kconfig.qcc730"
rsource "counter/Kconfig.qcc730"
rsource "dma/Kconfig.qcc730"
rsource "flash/Kconfig.qcc730"
rsource "gpio/Kconfig.qcc730"
rsource "i2c/Kconfig.qcc730"
rsource "pinctrl/Kconfig.qcc730"
rsource "reset/Kconfig.qcc730"
rsource "rtc/Kconfig.qcc730"
rsource "serial/Kconfig.qcc730"
rsource "spi/Kconfig"
rsource "watchdog/Kconfig.qcc730"
rsource "wifi/Kconfig"
endmenu
```

## drivers/clock_control/Kconfig.qcc730
```kconfig
# Copyright (c) Qualcomm Technologies, Inc. and/or its subsidiaries.
#
# SPDX-License-Identifier: Apache-2.0

config CLOCK_CONTROL_QCC730
	bool "QCC730 Clock Control Driver"
	default y
	depends on CLOCK_CONTROL
	depends on DT_HAS_QCOM_QCC730_CLKCTRL_ENABLED
	help
	  Enable support for the QCC730 clock control driver.
	  This driver provides clock control for UART, I2C, SPI,
	  QTIMER, Watchdog, and GPIO peripherals.
```

## drivers/counter/Kconfig.qcc730
```kconfig
# Copyright (c) Qualcomm Technologies, Inc. and/or its subsidiaries.
# SPDX-License-Identifier: Apache-2.0
# Qualcomm QCC730 qtimer configuration options

config COUNTER_QCC730
	bool "Qualcomm QCC730 counter/qtimer driver"
	default y if DT_HAS_QCOM_QCC730_QTMR_ENABLED
	depends on COUNTER
	help
	  Enable support for the Qualcomm QCC730 qtimer.

config COUNTER_QCC730_INIT_PRIORITY
	int "COUNTER QCC730 init priority"
	default KERNEL_INIT_PRIORITY_DEVICE
	help
	  The priority of QCC730 counter driver initialization.
```

## drivers/dma/Kconfig.qcc730
```kconfig
# Copyright (c) Qualcomm Technologies, Inc. and/or its subsidiaries.
# SPDX-License-Identifier: Apache-2.0
# Qualcomm QCC730 DMA configuration options

config DMA_QCC730
	bool "Qualcomm QCC730 DMA (DXE) driver"
	default y if DT_HAS_QCOM_QCC730_DXE_ENABLED
	select DMA
	help
	  Enable support for the Qualcomm QCC730 DMA (DXE) controller.
```

## drivers/drv_dummy/Kconfig
```kconfig
# Copyright (c) Qualcomm Technologies, Inc. and/or its subsidiaries.
# SPDX-License-Identifier: Apache-2.0;
config DRV_DUMMY
	bool "Dummy driver"
	default n

if DRV_DUMMY

module = DRV_DUMMY
module-str = drv_dummy
source "subsys/logging/Kconfig.template.log_config"

rsource "./Kconfig.*"

endif # DRV_DUMMY
```

## drivers/drv_dummy/Kconfig.qcc730
```kconfig
# Copyright (c) Qualcomm Technologies, Inc. and/or its subsidiaries.
# SPDX-License-Identifier: Apache-2.0;
config DRV_DUMMY_QCC730
	bool "Qualcomm qcc730 dummy driver"
	depends on DRV_DUMMY
	depends on SOC_QCC730
	help
	  Enable the dummy driver implementation

if DRV_DUMMY_QCC730

endif # DRV_DUMMY_QCC730
```

## drivers/flash/Kconfig.qcc730
```kconfig
# Copyright (c) Qualcomm Technologies, Inc. and/or its subsidiaries.
# SPDX-License-Identifier: Apache-2.0
# Qualcomm QCC730 FLASH configuration options

config FLASH_QCC730
	bool "Qualcomm QCC730 FLASH driver"
	default y
	select FLASH_HAS_DRIVER_ENABLED
	select FLASH_HAS_EXPLICIT_ERASE
	select FLASH_HAS_PAGE_LAYOUT
	depends on DT_HAS_QCOM_QSPI_QCC730_NOR_ENABLED
	help
	  Enable support for the Qualcomm QCC730 FLASH controllers.

if FLASH_QCC730

config FLASH_QCC730_QSPI_WRITE_BLOCK_SIZE
	int "QCC730 QSPI Flash driver size of write block"
	default 1
	help
	  Determine size of a block written by QCC730 FLASH controller.

config FLASH_QCC730_QSPI_QUAD_MODE
	bool "QCC730 QSPI Quad mode"
	default y
	help
	  Enable Quad mode which uses all 4 communication lines for data transmission.

config FLASH_QCC730_XIP_MODE
	bool "QCC730 QSPI XIP mode"
	default n
	help
	  Enable XIP mode for flash

endif # FLASH_QCC730
```

## drivers/gpio/Kconfig.qcc730
```kconfig
# Copyright (c) Qualcomm Technologies, Inc. and/or its subsidiaries.
# SPDX-License-Identifier: Apache-2.0
# Qualcomm QCC730 GPIO configuration options

config GPIO_QCC730
	bool "Qualcomm QCC730 GPIO driver"
	default y
	depends on DT_HAS_QCOM_QCC730_GPIO_ENABLED
	help
	  Enable support for the Qualcomm QCC730 GPIO controllers.

config GPIO_QCC730_INTERRUPT
	bool "Interrupt support for QCC730 GPIO driver"
	default y
	depends on GPIO_QCC730
	help
	  Enable interrupt support for QCC730 GPIO driver.
```

## drivers/i2c/Kconfig.qcc730
```kconfig
# Copyright (c) Qualcomm Technologies, Inc. and/or its subsidiaries.
# SPDX-License-Identifier: Apache-2.0
# Qualcomm QCC730 I2C configuration options

config I2C_QCC730
	bool "Qualcomm QCC730 I2C driver"
	default y
	depends on I2C
	depends on DT_HAS_QCOM_QCC730_I2C_ENABLED
	help
	  Enable support for the Qualcomm QCC730 I2C controllers.

if I2C_QCC730
config I2C_QCC730_TIMEOUT_MS
	int "QCC730 I2C operations timeout in miliseconds"
	default 1000
	help
	  If this timeout will be exceeded - I2C operation will return
	  with ETIMEDOUT error code.

config I2C_QCC730_INTERRUPT_SUPPORT
	bool "Interrupt support for QCC730 I2C driver"
	default n
	help
	  Enable interrupts support for Qualcomm QCC730 I2C driver.
	  If this value is not defined - driver will work in polling mode.
endif
```

## drivers/pinctrl/Kconfig.qcc730
```kconfig
# Copyright (c) 2025 Qualcomm Technologies, Inc. and/or its subsidiaries
# SPDX-License-Identifier: Apache-2.0

config PINCTRL_QCC730
	bool "Qualcomm QCC730 pin control driver"
	default y
	depends on PINCTRL
	depends on DT_HAS_QCOM_QCC730_PINCTRL_ENABLED
	help
	  Qualcomm QCC730 pin control driver.
```

## drivers/reset/Kconfig.qcc730
```kconfig
# Copyright (c) Qualcomm Technologies, Inc. and/or its subsidiaries.
# SPDX-License-Identifier: Apache-2.0
# Qualcomm QCC730 GPIO configuration options

config RESET_QCC730
	bool "Qualcomm QCC730 Reset driver"
	default y if DT_HAS_QCOM_QCC730_RESET_ENABLED
	select RESET
	help
	  Enable support for the Qualcomm QCC730 Reset function.

config RESET_LOG_LEVEL
	int "Log level for reset controller drivers"
	default 2
	range 0 4
	help
	  Sets the log level for reset controller drivers.
	  0=Off, 1=Error, 2=Warning, 3=Info, 4=Debug
```

## drivers/rtc/Kconfig.qcc730
```kconfig
# Copyright (c) Qualcomm Technologies, Inc. and/or its subsidiaries.
# SPDX-License-Identifier: Apache-2.0
# Qualcomm QCC730 RTC configuration options

config RTC_QCC730
	bool "Qualcomm QCC730 RTC driver"
	default y if DT_HAS_QCOM_QCC730_RTC_ENABLED
	depends on RTC && COUNTER
	help
	  Enable support for the Qualcomm QCC730 RTC driver.

config RTC_QCC730_INIT_PRIORITY
	int "QCC730 RTC init priority"
	default 60
	depends on RTC_QCC730
	help
	  The priority of QCC730 RTC driver initialization.
	  Must be greater (later) than the qtimer/counter init priority.
```
