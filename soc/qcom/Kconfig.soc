## soc/qcom/Kconfig.soc
```kconfig
# Copyright (c) Qualcomm Technologies, Inc. and/or its subsidiaries.
# SPDX-License-Identifier: Apache-2.0;
config SOC_FAMILY_QCOM
	bool "SOC Family for Qcom"
	select BUILD_OUTPUT_HEX
    select HAS_PM

config SOC_FAMILY
	default "qcom" if SOC_FAMILY_QCOM
```

## soc/qcom/qcc730/Kconfig.bdf
```kconfig
# Copyright (c) Qualcomm Technologies, Inc. and/or its subsidiaries.
# SPDX-License-Identifier: Apache-2.0

menuconfig QCC730_BDF_FILE
	string "BDF file name"
	help
	  BDF file name.
```

## soc/qcom/qcc730/Kconfig.defconfig
```kconfig
# Copyright (c) Qualcomm Technologies, Inc. and/or its subsidiaries.
# SPDX-License-Identifier: Apache-2.0;
if SOC_QCC730

config NUM_IRQS
	default 128

config SYS_CLOCK_HW_CYCLES_PER_SEC
	default 60000000

config SYS_CLOCK_TICKS_PER_SEC
	default 1000

config HEAP_MEM_POOL_SIZE
	default 262144

endif # SOC_QCC730
```

## soc/qcom/qcc730/Kconfig.prg
```kconfig
# Copyright (c) Qualcomm Technologies, Inc. and/or its subsidiaries.
# SPDX-License-Identifier: Apache-2.0

menuconfig QCC730_PRG_FILE
	string "PRG file name"
	help
	  PRG file name.
```

## soc/qcom/qcc730/Kconfig.sbl
```kconfig
# Copyright (c) Qualcomm Technologies, Inc. and/or its subsidiaries.
# SPDX-License-Identifier: Apache-2.0

menuconfig QCC730_SBL_FILE
	string "SBL file name"
	help
	  SBL file name.
```

## soc/qcom/qcc730/Kconfig.soc
```kconfig
# Copyright (c) Qualcomm Technologies, Inc. and/or its subsidiaries.
# SPDX-License-Identifier: Apache-2.0;
config SOC_SERIES_QCC730
	bool "SOC Series for Qcom QCC730"
	select SOC_FAMILY_QCOM
	help
	  Enable support for QCC730 Series

config SOC_SERIES
	default "qcc730" if SOC_SERIES_QCC730

config SOC_QCC730
	bool
	default n
	select SOC_SERIES_QCC730
	select ARM
	select CPU_CORTEX_M4
	select CPU_HAS_FPU
	select HAS_PM
	select XIP
	select SOC_QCC730_HAS_UART_V2
	select SOC_QCC730_HAS_XPA_AUTO_CTRL
	select SOC_QCC730_HAS_BT_COEX
	select SOC_QCC730_HAS_I2C
	select SOC_QCC730_HAS_QSPI_V2
	select SOC_QCC730_HAS_SPI_SLAVE
	select SOC_EARLY_RESET_HOOK
	select SOC_PREP_HOOK
	select SOC_EARLY_INIT_HOOK
	select SKIP_BSS_CLEAR if !XIP
	select QPOWER
	select HAS_SEGGER_RTT if ZEPHYR_SEGGER_MODULE

config SOC
	default "qcc730" if SOC_QCC730
```

## soc/qualcomm/Kconfig
```kconfig
# Copyright (c) Qualcomm Technologies, Inc. and/or its subsidiaries.
# SPDX-License-Identifier: Apache-2.0;
rsource "Kconfig.soc"
rsource "Kconfig.defconfig"
rsource "*/Kconfig"
```

## soc/qualcomm/Kconfig.soc
```kconfig
# Copyright (c) Qualcomm Technologies, Inc. and/or its subsidiaries.
# SPDX-License-Identifier: Apache-2.0;
config SOC_FAMILY_QUALCOMM
	bool "SOC Family for Qualcomm"
	select BUILD_OUTPUT_HEX
    select HAS_PM

config SOC_FAMILY
	default "qualcomm" if SOC_FAMILY_QUALCOMM
```

## soc/qualcomm/qcc730/Kconfig
```kconfig
# Copyright (c) Qualcomm Technologies, Inc. and/or its subsidiaries.
# SPDX-License-Identifier: Apache-2.0;
rsource "Kconfig.peripherals"
rsource "Kconfig.soc"
rsource "Kconfig.defconfig"
```

## soc/qualcomm/qcc730/Kconfig.defconfig
```kconfig
# Copyright (c) Qualcomm Technologies, Inc. and/or its subsidiaries.
# SPDX-License-Identifier: Apache-2.0;
if SOC_QCC730

config NUM_IRQS
	default 64

endif # SOC_QCC730
```

## soc/qualcomm/qcc730/Kconfig.peripherals
```kconfig
# Copyright (c) Qualcomm Technologies, Inc. and/or its subsidiaries.
# SPDX-License-Identifier: Apache-2.0;
config SOC_QCC730_HAS_UART_V1
	bool "SOC QCC730 HAS UART V1, only GPIO_11/12"
	default n

config SOC_QCC730_HAS_UART_V2
	bool "SOC QCC730 HAS UART V2, has 4 options as BOARD_QCC730_UART_GPIO_OPTION"
	default n

config SOC_QCC730_HAS_XPA_AUTO_CTRL
	bool "SOC QCC730 HAS XPA AUTO CTRL"
	default n

config SOC_QCC730_HAS_BT_COEX
	bool "SOC QCC730 HAS BT COEX"
	default n

config SOC_QCC730_HAS_I2C
	bool "SOC QCC730 HAS I2C"
	default n

config SOC_QCC730_HAS_QSPI_V1
	bool "SOC QCC730 HAS QSPI V1, only support 2 BITS"
	default n

config SOC_QCC730_HAS_QSPI_V2
	bool "SOC QCC730 HAS QSPI V2, support 2/4 BITS"
	default n

config SOC_QCC730_HAS_SPI_SLAVE
	bool "SOC QCC730 HAS SPI SLAVE"
	default n

#################################################################
#boards capable configuration

config BOARD_QCC730_I2C_ENABLE
	bool "BOARD QCC730 I2C ENABLE"
	depends on SOC_QCC730_HAS_I2C
	default n

config BOARD_QCC730_BT_COEX_ENABLE
	bool "BOARD QCC730 BT COEX ENABLE"
	depends on SOC_QCC730_HAS_BT_COEX
	default n

config BOARD_QCC730_BT_COEX_MODE
	int "BOARD QCC730 BT COEX MODE"
	range 0 3
	depends on BOARD_QCC730_BT_COEX_ENABLE
	default 0

config BOARD_QCC730_QSPI_ENABLE
	bool "BOARD QCC730 QSPI ENABLE"
	depends on SOC_QCC730_HAS_QSPI_V1 || SOC_QCC730_HAS_QSPI_V2
	default n

config BOARD_QCC730_QSPI_V1_OPTION
	int "BOARD QCC730 QSPI V1 option. 0: GPIO_4/5/6/7; 1: GPIO_4/11/12/14"
	depends on BOARD_QCC730_QSPI_ENABLE && SOC_QCC730_HAS_QSPI_V1
	range 0 1
	default 0

config BOARD_QCC730_QSPI_V2_QUAD_MODE
	int "BOARD QCC730 QSPI V2 QUAD mode. 0: only QSPI 2 bits on GPIO_4/5/6/7; 1: QSPI 4 bits on GPIO_4/5/6/7/11/12"
	depends on BOARD_QCC730_QSPI_ENABLE && SOC_QCC730_HAS_QSPI_V2
	range 0 1
	default 1

config BOARD_QCC730_UART_ENABLE
	bool "BOARD QCC730 uart enable"
	depends on SOC_QCC730_HAS_UART_V1 || SOC_QCC730_HAS_UART_V2
	default n

config BOARD_QCC730_UART_GPIO_OPTION
	int "BOARD QCC730 UART GPIO options. 0: GPIO_11/12; 1: GPIO_13/14; 2: GPIO_9/10; 3: GPIO_1/3"
	range 0 3
	depends on BOARD_QCC730_UART_ENABLE && SOC_QCC730_HAS_UART_V2
	default 0

config BOARD_QCC730_SPI_SLAVE_ENABLE
	bool "BOARD QCC730 SPI slave enable"
	depends on SOC_QCC730_HAS_SPI_SLAVE
	default n

config BOARD_QCC730_SPI_SLAVE_OPTION
	int "BOARD QCC730 SPI SLAVE options. 0: DWSPI; 1: QCSPI"
	range 0 1
	depends on BOARD_QCC730_SPI_SLAVE_ENABLE
	default 0
```

## west.yml
```yaml
# Copyright (c) Qualcomm Technologies, Inc. and/or its subsidiaries.
# SPDX-License-Identifier: Apache-2.0;
manifest:
  remotes:
    - name: upstream
      url-base: ssh://review-android.quicinc.com:29418/qzephyr/upstream
    - name: qoss
      url-base: ssh://review-android.quicinc.com:29418/qzephyr/qoss
    - name: 3rdparty
      url-base: ssh://review-android.quicinc.com:29418/qzephyr/3rdparty
    - name: prop
      url-base: ssh://review-android.quicinc.com:29418/qzephyr/prop
    - name: zephyrproject-rtos
      url-base: ssh://review-android.quicinc.com:29418/qzephyr/zephyrproject-rtos
  defaults:
    remote: zephyrproject-rtos
    revision: main
  projects:
    - name: zephyr
      remote: zephyrproject-rtos
      revision: kernel.qzephyr.2.0
      import:
        # By using name-allowlist we can clone only the modules that are
        # strictly needed by the application.
        name-allowlist:
          - zcbor      # for c++ programming
    - name: cmsis_6
      remote: zephyrproject-rtos
      revision: cmsis_6.qzephyr.2.0
      path: modules/hal/cmsis_6
    - name: cAT
      remote: 3rdparty
      revision: 3rdparty.qzephyr.1.0
      path: modules/lib/cAT
    - name: mbedtls
      remote: zephyrproject-rtos
      revision: mbedtls.qzephyr.2.0
      path: modules/crypto/mbedtls
    - name: hostap
      remote: zephyrproject-rtos
      revision: hostap.qzephyr.2.0
      path: modules/lib/hostap
    - name: littlefs
      remote: zephyrproject-rtos
      revision: littlefs.qzephyr.2.0
      path: modules/fs/littlefs
    - name: segger
      remote: zephyrproject-rtos
      revision: segger.qzephyr.2.0
      path: modules/debug/segger
    - name: qapp
      remote: qoss
      revision: qcc730.qzephyr.2.0
    - name: qhal
      remote: upstream
      revision: qcc730.qzephyr.2.0
      path: modules/hal/qcom
    - name: libpowerqcc730
      remote: prop
      revision: qcc730.qzephyr.2.0
      path: prop/libpowerqcc730
    - name: libwifiqcc730
      remote: prop
      revision: qcc730.qzephyr.2.0
      path: prop/libwifiqcc730
    - name: libsensorqcc730
      remote: prop
      revision: qcc730.qzephyr.2.0
      path: prop/libsensorqcc730
    - name: libcryptoqcc730
      remote: prop
      revision: qcc730.qzephyr.2.0
      path: prop/libcryptoqcc730
  self:
    west-commands: zephyr/scripts/west-commands.yml
```
